## firmware/zmk/boards/shields/yampad/Kconfig.shield
```kconfig
# Copyright (c) 2025 The ZMK Contributors
# SPDX-License-Identifier: MIT

config SHIELD_YAMPAD
    def_bool $(shields_list_contains,yampad)
```
